## boards/wireless/icebreaker/Kconfig.board
```kconfig
# SPDX-License-Identifier: MIT

config BOARD_ICEBREAKER
	bool "Icebreaker Keyboard"
	depends on SOC_NRF52840_QIAA
```

## boards/wireless/icebreaker/icebreaker_defconfig
```kconfig
# SPDX-License-Identifier: MIT

CONFIG_SOC_SERIES_NRF52X=y
CONFIG_SOC_NRF52840_QIAA=y

CONFIG_BOARD_ICEBREAKER=y

# Power management
# Deep sleep - enters after 15 min idle, wakes on key press
CONFIG_ZMK_SLEEP=y
CONFIG_ZMK_IDLE_SLEEP_TIMEOUT=900000

# Soft off - for shipping/storage, nearly zero power draw
# Wake requires holding a specific key combo
CONFIG_ZMK_PM_SOFT_OFF=y

# Enable MPU
CONFIG_ARM_MPU=y

# Enable GPIO
CONFIG_GPIO=y

# Enable EC11 encoder
CONFIG_EC11=y
CONFIG_EC11_TRIGGER_GLOBAL_THREAD=y

CONFIG_USE_DT_CODE_PARTITION=y
CONFIG_BUILD_OUTPUT_UF2=y

CONFIG_MPU_ALLOW_FLASH_WRITE=y
CONFIG_NVS=y
CONFIG_SETTINGS=y
CONFIG_SETTINGS_NVS=y
CONFIG_FLASH=y
CONFIG_FLASH_PAGE_LAYOUT=y
CONFIG_FLASH_MAP=y

# Save settings immediately (default is 60 seconds)
CONFIG_ZMK_SETTINGS_SAVE_DEBOUNCE=0

# Enable I2C
CONFIG_I2C=y
CONFIG_I2C_NRFX=y

CONFIG_PINCTRL=y

# Enable USB
CONFIG_ZMK_USB=y

# Enable unique USB serial number from hardware ID
CONFIG_USB_DEVICE_SN="0000000000000000"

# Enable BLE
CONFIG_ZMK_BLE=y

# Enable dynamic BT name and increase max for serial suffix "Icebreaker Wireless XXXX"
CONFIG_BT_DEVICE_NAME_DYNAMIC=y
CONFIG_BT_DEVICE_NAME_MAX=28

# Windows Battery Reporting Fix
CONFIG_BT_GATT_ENFORCE_SUBSCRIPTION=n

# Enable ZMK Studio support (locking disabled for easy access)
CONFIG_ZMK_STUDIO=y
CONFIG_ZMK_STUDIO_LOCKING=n

# Enable CDC ACM UART for ZMK Studio USB connection
CONFIG_USB_CDC_ACM=y
CONFIG_SERIAL=y
CONFIG_UART_INTERRUPT_DRIVEN=y

# Enable RGB underglow
CONFIG_ZMK_RGB_UNDERGLOW=y
CONFIG_WS2812_STRIP=y
CONFIG_SPI=y
CONFIG_ZMK_RGB_UNDERGLOW_ON_START=y

# Enable external power control (for LED power rail)
CONFIG_ZMK_EXT_POWER=y

# RGB brightness settings
# Max brightness hard limited to 31%
CONFIG_ZMK_RGB_UNDERGLOW_BRT_MAX=31
# Minimum brightness 1%
CONFIG_ZMK_RGB_UNDERGLOW_BRT_MIN=1
# Smaller step increments (default is 10)
CONFIG_ZMK_RGB_UNDERGLOW_BRT_STEP=3
# Start at 20% brightness
CONFIG_ZMK_RGB_UNDERGLOW_BRT_START=20

# Logging disabled
# CONFIG_ZMK_USB_LOGGING=y
```

## config/boards/arm/icebreaker/Kconfig.defconfig
```kconfig
# SPDX-License-Identifier: MIT

if BOARD_ICEBREAKER

config BOARD
	default "icebreaker"

config ZMK_KEYBOARD_NAME
	default "Icebreaker"

# Enable HWINFO for unique device identification (last 4 hex of serial)
config HWINFO
	default y

# Enable dynamic BT name (required for runtime suffix addition)
config BT_DEVICE_NAME_DYNAMIC
	default y

# Increase max BT device name to fit "Icebreaker Wireless XXXX" (24 chars)
config BT_DEVICE_NAME_MAX
	default 28

if USB_DEVICE_STACK

config USB_NRFX
	default y

endif # USB_DEVICE_STACK

config BT_CTLR
	default BT

endif # BOARD_ICEBREAKER
```

## config/boards/arm/icebreaker/Kconfig.icebreaker
```kconfig
# Copyright (c) 2020 The ZMK Contributors
# SPDX-License-Identifier: MIT

config BOARD_ICEBREAKER
    select SOC_NRF52840_QIAA
```

## config/west.yml
```yaml
manifest:
  remotes:
    - name: serene-industries
      url-base: https://github.com/serene-industries
  projects:
    # Patched ZMK core (RGB persistence, custom Studio subsystems, the board's
    # app-level sources). Imports zephyr + modules + the custom
    # zmk-studio-messages (lighting/ble/stats protos) via the fork's app/west.yml.
    - name: zmk
      remote: serene-industries
      revision: icebreaker-studio
      import: app/west.yml
  self:
    path: config
```
